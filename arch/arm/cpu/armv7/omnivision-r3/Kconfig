## arch/arm/cpu/armv7/omnivision-r3/Kconfig
```kconfig
if ARCH_OMNIVISION_R3

config SYS_SOC
	default "omnivision-r3"

choice
	prompt "OV798 board select"
	optional

config TARGET_OV798_NOFLASH
	bool "OV798 No Flash board"

endchoice


source "board/omnivision/ov798_noflash/Kconfig"

endif
```

## board/omnivision/ov798_noflash/Kconfig
```kconfig
if TARGET_OV798_NOFLASH

config SYS_BOARD
	default "ov798_noflash"

config SYS_VENDOR
	default "omnivision"

config SYS_CONFIG_NAME
	default "ov798_noflash"

endif
```
